// SPDX-License-Identifier: (GPL-2.0 OR MIT)
/*
 * Copyright 2021 Google LLC
 */

/dts-v1/;
#include "mt8183-kukui-jacuzzi-cerise.dtsi"
#include "mt8183-kukui-audio-ts3a227e-rt1015p.dtsi"

/ {
	model = "Google stern board";
	chassis-type = "convertible";
	compatible = "google,cerise-rev3-sku1", "google,cerise", "mediatek,mt8183";
};

&mt6358codec {
	mediatek,dmic-mode = <0>; /* two-wire */
};

&touchscreen {
	compatible = "hid-over-i2c";

	post-power-on-delay-ms = <10>;
	hid-descr-addr = <0x0001>;
};

&qca_wifi {
	qcom,ath10k-calibration-variant = "GO_STERN";
};
