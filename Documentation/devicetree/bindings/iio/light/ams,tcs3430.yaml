## Documentation/devicetree/bindings/iio/light/ams,tcs3430.yaml
```yaml
# SPDX-License-Identifier: (GPL-2.0-only OR BSD-2-Clause)
%YAML 1.2
---
$id: http://devicetree.org/schemas/iio/light/ams,tcs3430.yaml#
$schema: http://devicetree.org/meta-schemas/core.yaml#

title: ams OSRAM TCS3430 XYZ Tristimulus Color and Ambient Light Sensor

maintainers:
  - robertijtsma <37256770+robertijtsma@users.noreply.github.com>

description: |
  The ams OSRAM TCS3430 is an I2C ambient light and CIE 1931 XYZ tristimulus
  color sensor with photopic Y, Z, X, and IR1 channels.

properties:
  compatible:
    const: ams,tcs3430

  reg:
    maxItems: 1

  interrupts:
    maxItems: 1

required:
  - compatible
  - reg

additionalProperties: false

examples:
  - |
    #include <dt-bindings/interrupt-controller/irq.h>

    i2c {
        #address-cells = <1>;
        #size-cells = <0>;

        light-sensor@39 {
            compatible = "ams,tcs3430";
            reg = <0x39>;
            interrupts = <24 IRQ_TYPE_LEVEL_LOW>;
        };
    };
...
```

## Documentation/devicetree/bindings/media/i2c/ovti,ov13858.yaml
```yaml
# SPDX-License-Identifier: (GPL-2.0-only OR BSD-2-Clause)
%YAML 1.2
---
$id: http://devicetree.org/schemas/media/i2c/ovti,ov13858.yaml#
$schema: http://devicetree.org/meta-schemas/core.yaml#

title: OmniVision OV13858 CMOS Image Sensor

maintainers:
  - robertijtsma <37256770+robertijtsma@users.noreply.github.com>

description: |
  The OmniVision OV13858 is a 1/3.06-inch, 13-megapixel CMOS image sensor
  supporting up to 4224x3136 active resolution over a 4-lane MIPI CSI-2
  interface and controlled via I2C (SCCB).

allOf:
  - $ref: /schemas/media/video-interface-devices.yaml#

properties:
  compatible:
    const: ovti,ov13858

  reg:
    maxItems: 1

  clocks:
    description: System input clock (XVCLK), 19.2 MHz.
    maxItems: 1

  clock-names:
    const: xvclk

  reset-gpios:
    description:
      Reference to the GPIO connected to the sensor reset / shutdown pin.
    maxItems: 1

  port:
    description: MIPI CSI-2 transmitter port
    $ref: /schemas/graph.yaml#/$defs/port-base
    additionalProperties: false

    properties:
      endpoint:
        $ref: /schemas/media/video-interfaces.yaml#
        unevaluatedProperties: false

        properties:
          link-frequencies: true

          data-lanes:
            minItems: 1
            maxItems: 4

        required:
          - data-lanes
          - link-frequencies

required:
  - compatible
  - reg
  - clocks
  - port

unevaluatedProperties: false

examples:
  - |
    #include <dt-bindings/gpio/gpio.h>

    i2c {
        #address-cells = <1>;
        #size-cells = <0>;

        camera@10 {
            compatible = "ovti,ov13858";
            reg = <0x10>;

            clocks = <&camcc 0>;
            clock-names = "xvclk";
            reset-gpios = <&tlmm 22 GPIO_ACTIVE_HIGH>;

            port {
                ov13858_ep: endpoint {
                    remote-endpoint = <&csiphy2_in>;
                    data-lanes = <1 2 3 4>;
                    link-frequencies = /bits/ 64 <540000000>;
                };
            };
        };
    };
...
```
