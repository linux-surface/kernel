## Documentation/devicetree/bindings/firmware/qcom,qseecom.yaml
```yaml
# SPDX-License-Identifier: (GPL-2.0 OR BSD-2-Clause)
%YAML 1.2
---
$id: http://devicetree.org/schemas/firmware/qcom,qseecom.yaml#
$schema: http://devicetree.org/meta-schemas/core.yaml#

title: Qualcomm Secure Execution Environment Communication Interface

maintainers:
  - Maximilian Luz <luzmaximilian@gmail.com>

description: |
  QSEECOM provides an interface to Qualcomm's Secure Execution Environment
  (SEE) running in the Trust Zone via SCM calls. In particular, it allows
  communication with secure applications running therein.

  Applications running in this environment can, for example, include
  'uefisecapp', which is required for accessing UEFI variables on certain
  systems as these cannot be accessed directly.

properties:
  compatible:
    items:
      - enum:
          - qcom,qseecom-sc8280xp
      - const: qcom,qseecom

  qcom,scm:
    $ref: '/schemas/types.yaml#/definitions/phandle'
    description:
      A phandle pointing to the QCOM SCM device (see ./qcom,scm.yaml).

required:
  - compatible
  - qcom,scm

additionalProperties: false

examples:
  - |
    firmware {
        scm {
            compatible = "qcom,scm-sc8280xp", "qcom,scm";
        };
        qseecom {
            compatible = "qcom,qseecom-sc8280xp", "qcom,qseecom";
            qcom,scm = <&scm>;
        };
    };
```

## Documentation/devicetree/bindings/firmware/qcom,tee-uefisecapp.yaml
```yaml
# SPDX-License-Identifier: (GPL-2.0 OR BSD-2-Clause)
%YAML 1.2
---
$id: http://devicetree.org/schemas/soc/qcom/qcom,rpmh-rsc.yaml#
$schema: http://devicetree.org/meta-schemas/core.yaml#

title: Qualcomm Trusted Execution Environment UEFI Secure Application

maintainers:
  - Maximilian Luz <luzmaximilian@gmail.com>

description: |
  Various Qualcomm SoCs do not allow direct access to UEFI variables. Instead,
  these need to be accessed via the UEFI Secure Application (uefisecapp),
  residing in the Trusted Execution Environment (TrEE). These bindings mark the
  presence of uefisecapp and allow the respective client driver to load and
  install efivar operations, providing the kernel with access to UEFI
  variables.

properties:
  compatible:
    const: qcom,tee-uefisecapp

required:
  - compatible

additionalProperties: false

examples:
  - |
    firmware {
        scm {
            compatible = "qcom,scm-sc8180x", "qcom,scm";
        };
        tee-uefisecapp {
            compatible = "qcom,tee-uefisecapp";
        };
    };
```

## Documentation/devicetree/bindings/interconnect/qcom,sc8180x-rpmh.yaml
```yaml
# SPDX-License-Identifier: GPL-2.0-only OR BSD-2-Clause
%YAML 1.2
---
$id: http://devicetree.org/schemas/interconnect/qcom,sc8180x-rpmh.yaml#
$schema: http://devicetree.org/meta-schemas/core.yaml#

title: Qualcomm RPMh Network-On-Chip Interconnect on SC8180X

maintainers:
  - Bjorn Andersson <andersson@kernel.org>
  - Konrad Dybcio <konrad.dybcio@linaro.org>

description: |
  RPMh interconnect providers support system bandwidth requirements through
  RPMh hardware accelerators known as Bus Clock Manager (BCM).

  See also:: include/dt-bindings/interconnect/qcom,sc8180x.h

properties:
  compatible:
    enum:
      - qcom,sc8180x-aggre1-noc
      - qcom,sc8180x-aggre2-noc
      - qcom,sc8180x-camnoc-virt
      - qcom,sc8180x-compute-noc
      - qcom,sc8180x-config-noc
      - qcom,sc8180x-dc-noc
      - qcom,sc8180x-gem-noc
      - qcom,sc8180x-ipa-virt
      - qcom,sc8180x-mc-virt
      - qcom,sc8180x-mmss-noc
      - qcom,sc8180x-qup-virt
      - qcom,sc8180x-system-noc

required:
  - compatible

allOf:
  - $ref: qcom,rpmh-common.yaml#

unevaluatedProperties: false

examples:
  - |
    interconnect-0 {
        compatible = "qcom,sc8180x-camnoc-virt";
        #interconnect-cells = <2>;
        qcom,bcm-voters = <&apps_bcm_voter>;
    };
```

## Documentation/devicetree/bindings/interrupt-controller/fsl,mu-msi.yaml
```yaml
# SPDX-License-Identifier: (GPL-2.0-only OR BSD-2-Clause)
%YAML 1.2
---
$id: http://devicetree.org/schemas/interrupt-controller/fsl,mu-msi.yaml#
$schema: http://devicetree.org/meta-schemas/core.yaml#

title: NXP i.MX Messaging Unit (MU)

maintainers:
  - Frank Li <Frank.Li@nxp.com>

description: |
  The Messaging Unit module enables two processors within the SoC to
  communicate and coordinate by passing messages (e.g. data, status
  and control) through the MU interface. The MU also provides the ability
  for one processor to signal the other processor using interrupts.

  Because the MU manages the messaging between processors, the MU uses
  different clocks (from each side of the different peripheral buses).
  Therefore, the MU must synchronize the accesses from one side to the
  other. The MU accomplishes synchronization using two sets of matching
  registers (Processor A-facing, Processor B-facing).

  MU can work as msi interrupt controller to do doorbell

properties:
  compatible:
    oneOf:
      - const: fsl,imx6sx-mu-msi
      - const: fsl,imx7ulp-mu-msi
      - const: fsl,imx8ulp-mu-msi
      - const: fsl,imx8-mu-msi
      - const: fsl,imx8ulp-mu-msi-s4
      - items:
          - const: fsl,imx8ulp-mu-msi
      - items:
          - enum:
              - fsl,imx7s-mu-msi
              - fsl,imx8mq-mu-msi
              - fsl,imx8mm-mu-msi
              - fsl,imx8mn-mu-msi
              - fsl,imx8mp-mu-msi
              - fsl,imx8qm-mu-msi
              - fsl,imx8qxp-mu-msi
          - const: fsl,imx6sx-mu-msi
      - description: MU work as msi controller
        items:
          - enum:
              - fsl,imx8qm-mu-msi
              - fsl,imx8qxp-mu-msi
          - const: fsl,imx6sx-mu-msi
  reg:
    maxItems: 2

  interrupts:
    minItems: 1
    maxItems: 2

  interrupt-names:
    minItems: 1
    items:
      - const: tx
      - const: rx

  clocks:
    maxItems: 1

  power-domains:
    maxItems: 1

required:
  - compatible
  - reg
  - interrupts
  - msi-controller

additionalProperties: false

examples:
  - |
    #include <dt-bindings/interrupt-controller/arm-gic.h>

    lsio_mu12: msi@5d270000 {
               compatible = "fsl,imx6sx-mu-msi-db";
               msi-controller;
               interrupt-controller;
               reg = <0x5d270000 0x10000>,     /* A side */
                     <0x5d300000 0x10000>;     /* B side */
               reg-names = "a", "b";
               interrupts = <GIC_SPI 191 IRQ_TYPE_LEVEL_HIGH>;
               power-domains = <&pd IMX_SC_R_MU_12A>,
                               <&pd IMX_SC_R_MU_12B>;
               power-domain-names = "a", "b";
    };
```

## Documentation/devicetree/bindings/regulator/9elements,output-supply.yaml
```yaml
# SPDX-License-Identifier: (GPL-2.0 OR BSD-2-Clause)
%YAML 1.2
---
$id: http://devicetree.org/schemas/regulator/userspace-consumer.yaml#
$schema: http://devicetree.org/meta-schemas/core.yaml#

title: Regulator output-supply driver

maintainers:
  - Patrick Rudolph <patrick.rudolph@9elements.com>

description: |
  Regulator output-supply driver helps interact with regulator.
  Provides regulator events & sysfs notify to capture regulator events
  in realtime for userspace application.
  This enables userspace application to monitor events in regulator(s) &
  handle them appropriately.


properties:
  compatible:
    enum:
      - 9elements,output-supply

  regulator-name:
    description: Name of the consumer line

  regulator-boot-on:
    description: Enable regulator during boot

  regulator-supplies:
    description: Supply names for this regulator. This can be multiple strings

patternProperties:
  ".*-supply$":
    description: |
      Input supply phandle(s) for this node. There should be
      <supply-name>-supply to pass regulators handle

required:
  - compatible
  - regulator-supplies
  - ".*-supply$"

additionalProperties: false

examples:
  - |
    p12v_b_consumer {
        compatible = "9elements,output-supply";
        regulator-name = "BCM1";
        regulator-supplies = "vbus";
        vbus-supply = <&p12v_b>;
    };

    ssb_rssd32 {
        compatible = "9elements,output-supply";
        regulator-name = "ssb_rssd32";
        regulator-supplies = "sw0", "sw1";
        sw0-supply = <&sw0_ssb_rssd32>;
        sw1-supply = <&sw1_ssb_rssd32>;
    };
...
```

## arch/parisc/Kconfig.debug
```kconfig
# SPDX-License-Identifier: GPL-2.0
#
config LIGHTWEIGHT_IRQ_CHECK
	bool "Enable lightweight IRQ checks"
	depends on DEBUG_KERNEL && !DEBUG_IRQFLAGS
	default n
	help
	  Add checks with low performance impact to the irq functions
	  to check that irqs are correctly turned off in critical sections.
	  If unsure say N here.

config LIGHTWEIGHT_SPINLOCK_CHECK
	bool "Enable lightweight spinlock checks"
	depends on SMP && !DEBUG_SPINLOCK
	default y
	help
	  Add checks with low performance impact to the spinlock functions
	  to catch memory overwrites at runtime. For more advanced
	  spinlock debugging you should choose the DEBUG_SPINLOCK option
	  which will detect unitialized spinlocks too.
	  If unsure say Y here.

config TLB_PTLOCK
	bool "Use page table locks in TLB fault handler"
	depends on SMP
	default n
	help
	  Select this option to enable page table locking in the TLB
	  fault handler. This ensures that page table entries are
	  updated consistently on SMP machines at the expense of some
	  loss in performance.
```

## drivers/input/touchscreen/ipts/Kconfig
```kconfig
# SPDX-License-Identifier: GPL-2.0-or-later

config TOUCHSCREEN_IPTS
	tristate "Intel Precise Touch & Stylus"
	select INTEL_MEI
	depends on X86
	depends on PCI
	depends on HID
	help
	  Say Y here if your system has a touchscreen using Intels
	  Precise Touch & Stylus (IPTS).

	  If unsure say N.

	  To compile this driver as a module, choose M here: the
	  module will be called ipts.
```

## drivers/leds/rgb/Kconfig
```kconfig
# SPDX-License-Identifier: GPL-2.0

if LEDS_CLASS_MULTICOLOR

config LEDS_QCOM_LPG
	tristate "LED support for Qualcomm LPG"
	depends on OF
	depends on SPMI
	help
	  This option enables support for the Light Pulse Generator found in a
	  wide variety of Qualcomm PMICs.

	  If compiled as a module, the module will be named leds-qcom-lpg.

endif # LEDS_CLASS_MULTICOLOR
```

## drivers/misc/ipts/Kconfig
```kconfig
# SPDX-License-Identifier: GPL-2.0-or-later
config INTEL_IPTS
	tristate "Intel Precise Touch & Stylus"
	select INTEL_MEI
	depends on X86 && PCI && HID && DRM_I915
	help
	  Intel Precise Touch & Stylus support
	  Supported SoCs:
	  Intel Skylake
	  Intel Kabylake

source "drivers/misc/ipts/companion/Kconfig"
```

## drivers/misc/ipts/companion/Kconfig
```kconfig
# SPDX-License-Identifier: GPL-2.0-or-later
config INTEL_IPTS_SURFACE
	tristate "IPTS companion driver for Microsoft Surface"
	depends on INTEL_IPTS && ACPI
	help
	  IPTS companion driver for Microsoft Surface. This driver is
	  responsible for loading firmware using surface-specific hardware IDs.
	  If you have a Microsoft Surface using IPTS, select y or m here.
```

## drivers/misc/surface_aggregator/clients/Kconfig
```kconfig
config SURFACE_AGGREGATOR_DEBUGFS
	tristate "Surface System Aggregator Module DebugFS interface"
	depends on SURFACE_AGGREGATOR
	depends on DEBUG_FS
	default n
	help
	  Provides a DebugFS interface to the Surface System Aggregator Module
	  (SSAM) controller.

	  This option provides a module (called surface_aggregator_debugfs),
	  that, when loaded, will add a client device (and its respective
	  driver) to the SSAM controller. Said client device manages a DebugFS
	  interface (/sys/kernel/debug/surface_aggregator/controller), which can
	  be used by user-space tools to directly communicate with the SSAM EC
	  by sending requests and receiving the correspondign responses.

	  The provided interface is intended for debugging and development only,
	  and should not be used otherwise.
```

## drivers/misc/surface_sam/Kconfig
```kconfig
menuconfig SURFACE_SAM
	depends on ACPI
	tristate "Microsoft Surface/System Aggregator Module and Platform Drivers"
	help
	  Drivers for the Surface/System Aggregator Module (SAM) of Microsoft
	  Surface devices.

	  SAM is an embedded controller that provides access to various
	  functionalities on these devices, including battery status, keyboard
	  events (on the Laptops) and many more.

	  Say M/Y here if you have a Microsoft Surface device with a SAM device
	  (i.e. 5th generation or later).

config SURFACE_SAM_SSH
	tristate "Surface Serial Hub Driver"
	depends on SURFACE_SAM
	depends on SERIAL_DEV_BUS
	select CRC_CCITT
	default m
	help
	  Surface Serial Hub driver for 5th generation (or later) Microsoft
	  Surface devices.

	  This is the base driver for the embedded serial controller found on
	  5th generation (and later) Microsoft Surface devices (e.g. Book 2,
	  Laptop, Laptop 2, Pro 2017, Pro 6, ...). This driver itself only
	  provides access to the embedded controller (SAM) and subsequent
	  drivers are required for the respective functionalities.

	  If you have a 5th generation (or later) Microsoft Surface device, say
	  Y or M here.

config SURFACE_SAM_SSH_ERROR_INJECTION
	bool "Surface Serial Hub Error Injection Capabilities"
	depends on SURFACE_SAM_SSH
	depends on FUNCTION_ERROR_INJECTION
	default n
	help
	  Enable error injection capabilities for the Surface Serial Hub.
	  This is used to debug the driver, specifically the communication
	  interface. It is not required for normal use.

	  If you are not sure, say N here.

source "drivers/misc/surface_sam/clients/Kconfig"
```
