## Documentation/devicetree/bindings/input/hid-over-spi.yaml
```yaml
# SPDX-License-Identifier: (GPL-2.0-only OR BSD-2-Clause)
%YAML 1.2
---
$id: http://devicetree.org/schemas/input/hid-over-spi.yaml#
$schema: http://devicetree.org/meta-schemas/core.yaml#

title: HID over SPI Devices

maintainers:
  - Benjamin Tissoires <benjamin.tissoires@redhat.com>
  - Jiri Kosina <jkosina@suse.cz>
  - Jingyuan Liang <jingyliang@chromium.org>

description: |+
  HID over SPI provides support for various Human Interface Devices over the
  SPI bus. These devices can be for example touchpads, keyboards, touch screens
  or sensors.

  The specification has been written by Microsoft and is currently available
  here: https://www.microsoft.com/en-us/download/details.aspx?id=103325

  The Microsoft HID over SPI specification explicitly dictates that SPI
  opcodes and register addresses (such as input/output report addresses)
  are not standardized. Instead, the specification requires the system
  firmware (e.g., ACPI or Device Tree) to provide these board-specific
  parameters to the OS. Therefore, these varying parameters must be
  defined as properties in the Device Tree.

allOf:
  - $ref: /schemas/input/touchscreen/touchscreen.yaml#
  - $ref: /schemas/spi/spi-peripheral-props.yaml#

properties:
  compatible:
    items:
      - enum:
          - microsoft,g6-touch-digitizer
      - const: hid-over-spi

  reg:
    maxItems: 1

  interrupts:
    maxItems: 1

  reset-gpios:
    maxItems: 1
    description:
      GPIO specifier for the digitizer's reset pin (active low). The line must
      be flagged with GPIO_ACTIVE_LOW.

  vdd-supply:
    description:
      Regulator for the VDD supply voltage.

  input-report-header-address:
    $ref: /schemas/types.yaml#/definitions/uint32
    minimum: 0
    maximum: 0xffffff
    description:
      A value to be included in the Read Approval packet, listing an address of
      the input report header to be put on the SPI bus. This address has 24
      bits.

  input-report-body-address:
    $ref: /schemas/types.yaml#/definitions/uint32
    minimum: 0
    maximum: 0xffffff
    description:
      A value to be included in the Read Approval packet, listing an address of
      the input report body to be put on the SPI bus. This address has 24 bits.

  output-report-address:
    $ref: /schemas/types.yaml#/definitions/uint32
    minimum: 0
    maximum: 0xffffff
    description:
      A value to be included in the Output Report sent by the host, listing an
      address where the output report on the SPI bus is to be written to. This
      address has 24 bits.

  read-opcode:
    $ref: /schemas/types.yaml#/definitions/uint8
    description:
      Value to be used in Read Approval packets. 1 byte.

  write-opcode:
    $ref: /schemas/types.yaml#/definitions/uint8
    description:
      Value to be used in Write Approval packets. 1 byte.

required:
  - compatible
  - interrupts
  - reset-gpios
  - vdd-supply
  - input-report-header-address
  - input-report-body-address
  - output-report-address
  - read-opcode
  - write-opcode

unevaluatedProperties: false

examples:
  - |
    #include <dt-bindings/interrupt-controller/irq.h>
    #include <dt-bindings/gpio/gpio.h>

    spi {
      #address-cells = <1>;
      #size-cells = <0>;

      hid@0 {
        compatible = "microsoft,g6-touch-digitizer", "hid-over-spi";
        reg = <0x0>;
        interrupts-extended = <&gpio 42 IRQ_TYPE_EDGE_FALLING>;
        reset-gpios = <&gpio 27 GPIO_ACTIVE_LOW>;
        vdd-supply = <&pm8350c_l3>;
        pinctrl-names = "default";
        pinctrl-0 = <&ts_d6_int_bias>;
        input-report-header-address = <0x1000>;
        input-report-body-address = <0x1004>;
        output-report-address = <0x2000>;
        read-opcode = /bits/ 8 <0x0b>;
        write-opcode = /bits/ 8 <0x02>;
      };
    };
```

## Documentation/devicetree/bindings/media/i2c/st,vd55g.yaml
```yaml
# SPDX-License-Identifier: (GPL-2.0 OR BSD-2-Clause)
# Copyright (c) 2025 STMicroelectronics SA.
%YAML 1.2
---
$id: http://devicetree.org/schemas/media/i2c/st,vd55g.yaml#
$schema: http://devicetree.org/meta-schemas/core.yaml#

title: STMicroelectronics VD55G Family Global Shutter Image Sensors

maintainers:
  - Benjamin Mugnier <benjamin.mugnier@foss.st.com>
  - Sylvain Petinot <sylvain.petinot@foss.st.com>
  - Peter Marshall <pm@petermarshall.ca>

description: |-
 The STMicroelectronics VD55G family (VD55G0, VD55G1, and VD65G4) consists of
 global shutter image sensors. The VD55G0 has an array size of 644H x 604V.
 The VD55G1 and VD65G4 have an array size of 804H x 704V. They are programmable
 through I2C interface. The I2C address is fixed to 0x10.

 Image data is sent through MIPI CSI-2, which is configured as only 1 data
 lane. The sensor provides 4 GPIOS that can be used for external LED signal
 (synchronized with sensor integration periods).

allOf:
  - $ref: /schemas/media/video-interface-devices.yaml#

  - if:
      properties:
        compatible:
          contains:
            const: st,vd55g0
    then:
      properties:
        port:
          properties:
            endpoint:
              properties:
                link-frequencies:
                  items:
                    minimum: 375000000

properties:
  compatible:
    enum:
      - st,vd55g0
      - st,vd55g1
      - st,vd65g4
    description:
      VD55G0 and VD55G1 are monochrome variants, while VD65G4 is the color variant.

  reg:
    maxItems: 1

  clocks:
    maxItems: 1

  vcore-supply:
    description: Digital core power supply (1.15V)

  vddio-supply:
    description: Digital IO power supply (1.8V)

  vana-supply:
    description: Analog power supply (2.8V)

  reset-gpios:
    description: Sensor reset active low GPIO (XSHUTDOWN)
    maxItems: 1

  st,leds:
    description:
      List sensor's GPIOs used to control strobe light sources during exposure
      time. The numbers identify the sensor pin on which the illumination
      system is connected. GPIOs are active-high.
    $ref: /schemas/types.yaml#/definitions/uint32-array
    minItems: 1
    maxItems: 4
    items:
      minimum: 0
      maximum: 3

  port:
    $ref: /schemas/graph.yaml#/$defs/port-base
    additionalProperties: false

    properties:
      endpoint:
        $ref: /schemas/media/video-interfaces.yaml#
        unevaluatedProperties: false

        properties:
          data-lanes:
            items:
              - const: 1

          link-frequencies:
            maxItems: 1
            items:
              minimum: 125000000
              maximum: 600000000

          lane-polarities:
            minItems: 1
            maxItems: 2

        required:
          - data-lanes
          - link-frequencies

required:
  - compatible
  - reg
  - clocks
  - vcore-supply
  - vddio-supply
  - vana-supply
  - reset-gpios
  - port

unevaluatedProperties: false

examples:
  - |
    #include <dt-bindings/gpio/gpio.h>

    i2c {
        #address-cells = <1>;
        #size-cells = <0>;

        camera-sensor@10 {
            compatible = "st,vd55g1";
            reg = <0x10>;

            clocks = <&camera_clk_12M>;

            vcore-supply = <&camera_vcore_v1v15>;
            vddio-supply = <&camera_vddio_v1v8>;
            vana-supply = <&camera_vana_v2v8>;

            reset-gpios = <&gpio 5 GPIO_ACTIVE_LOW>;
            st,leds = <2>;

            orientation = <2>;
            rotation = <0>;

            port {
                endpoint {
                    data-lanes = <1>;
                    link-frequencies = /bits/ 64 <600000000>;
                    remote-endpoint = <&csiphy0_ep>;
                };
            };
        };
    };
```

## drivers/hid/spi-hid/Kconfig
```kconfig
# SPDX-License-Identifier: GPL-2.0-only
#
# Copyright (c) 2021 Microsoft Corporation
#

menuconfig SPI_HID
	tristate "SPI HID support"
	default y
	depends on SPI

if SPI_HID

config SPI_HID_CORE
	tristate
endif
```

## drivers/media/pci/intel/Kconfig
```kconfig
# SPDX-License-Identifier: GPL-2.0-only

source "drivers/media/pci/intel/ipu3/Kconfig"
source "drivers/media/pci/intel/ipu6/Kconfig"
source "drivers/media/pci/intel/ivsc/Kconfig"

config IPU_BRIDGE
	tristate "Intel IPU Bridge"
	depends on ACPI || COMPILE_TEST
	depends on I2C
	help
	  The IPU bridge is a helper library for Intel IPU drivers to
	  function on systems shipped with Windows.

	  Currently used by the ipu3-cio2 and atomisp drivers.

	  Supported systems include:

	  - Microsoft Surface models (except Surface Pro 3)
	  - The Lenovo Miix line (for example the 510, 520, 710 and 720)
	  - Dell 7285

config VIDEO_INTEL_IPU
	tristate "Intel IPU driver"
	depends on ACPI
	select IOMMU_API
	select IOMMU_IOVA
	select X86_DEV_DMA_OPS if X86
	select VIDEOBUF2_DMA_CONTIG
	select PHYS_ADDR_T_64BIT
	select COMMON_CLK
	help
	  Main driver for Intel Image Processing Unit. Say Y here.

choice
	prompt "Intel IPU generation type"
	depends on VIDEO_INTEL_IPU
	default VIDEO_INTEL_IPU4P

config VIDEO_INTEL_IPU4
	bool "Compile for IPU4 driver"
	help
	  Select IPU4 for Intel Apollo Lake (PCI ID 8086:5a88):
	  Celeron N3350, Pentium N4200 or Atom E3900 Series Imaging Unit.

config VIDEO_INTEL_IPU4P
	bool "Compile for IPU4P driver"
	help
	  Select IPU4P for Intel Ice Lake (PCI ID 8086 8a19).
	  Supported systems include:
	  - Surface Pro 7
	  - Surface Book 3
	  - Surface Laptop 3
	  - Dell XPS 13 7390 2-in-1

endchoice

choice
	prompt "Intel IPU hardware platform type"
	depends on VIDEO_INTEL_IPU
	default VIDEO_INTEL_IPU_SOC

config VIDEO_INTEL_IPU_SOC
	bool "Compile for SOC"
	help
	  Select for SOC platform

endchoice

config VIDEO_INTEL_IPU_FW_LIB
	bool "Compile firmware library"
	depends on VIDEO_INTEL_IPU
	default y
	help
	  If selected, the firmware hostlib css will be compiled

config VIDEO_INTEL_IPU_WERROR
	bool "Force GCC to throw errors instead of warnings when compiling"
	depends on VIDEO_INTEL_IPU
	depends on EXPERT
	depends on !COMPILE_TEST
	default n
	help
	  Adds -Werror to the build flags for the Intel IPU module.
	  Recommended for driver developers only.
```
